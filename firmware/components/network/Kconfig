## firmware/components/network/Kconfig
```kconfig
menu "Sniffer networking configuration"

    config HOSTSSID
    string "The SSID of the centralized host (ACCESS POINT)"
    default "sniffnet"
    help
        The controller tries to connect to a central computer that handles the logic.

    config AP_SSID
    string "Set the SSID of the AP"
    default "ESP32_SNIFF"
    
    config AP_PASSWORD
    string "Set the password of the AP"
    default "12344321"
    
    config HOSTPW
    string "The password of the centralized host (ACCESS POINT)"
    default "sniff1234"
    help
        The password to the access point

    config SERVERIP
    string "The IP address of the host running the listening server"
    default "0.0.0.0"
    help
        There should be a listening process on a machine that the microboard connects to, this defines the IP address

    config PORT
    int "The port number of the listening process running on the central host (default 58585)"
    default 58585
    help
        The port number of the listening process running on the central host (default 58585)

endmenu
```

## firmware/main/Kconfig
```kconfig
menu "Wi-Fi Sniffer General configuration"

    config CHANNEL_HOP_INTERVAL
    int "How long the sniffer stays on one channel (ms)"
    default 2000
    help
        Time spent per wifi channel, before moves to the next, total 13 channels

    config SNIFF_TIME_PER_CYCLE
    int "Time spent capturing packets before starting to transmit"
    default 30000
    help
        How long does the board sniff for packets before starting to transmit (ms)

    config MAX_LOG_ENTRIES
    int "Maximum captured packets per cycle"
    default 1000
    help
        The backup cap on the amount of packets captured before transmitting (flushing), primarily moderated based on time

    config TRANSMIT_TIME_PER_CYCLE
    int "Time spent transmitting packets before starting to capture again"
    default 10000
    help
        How long does the board transmit before starting to capture again (ms)
        
endmenu
```
